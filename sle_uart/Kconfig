## sle_uart/Kconfig
```kconfig
#===============================================================================
# @brief    Kconfig file.
# Copyright (c) @CompanyNameMagicTag 2023-2023. All rights reserved.
#===============================================================================

config SLE_UART_BUS
    int
    prompt "Set the UART BUS of the currrent sample."
    default 0
    depends on SAMPLE_SUPPORT_SLE_UART
    help
        This option means the UART BUS of the currrent sample.

config UART_TXD_PIN
    int
    prompt "Choose UART TXD pin."
    depends on SAMPLE_SUPPORT_SLE_UART
    default 17

config UART_RXD_PIN
    int
    prompt "Choose UART RXD pin."
    depends on SAMPLE_SUPPORT_SLE_UART
    default 18

choice
    prompt "Select sle uart type"
    default SAMPLE_SUPPORT_SLE_UART_SERVER
    config SAMPLE_SUPPORT_SLE_UART_SERVER
        bool "Enable SLE UART Server sample."
    config SAMPLE_SUPPORT_SLE_UART_CLIENT
        bool "Enable SLE UART Client sample."
endchoice


config SUPPORT_SLE_PERIPHERAL
    bool
    default y if (SAMPLE_SUPPORT_SLE_UART_SERVER)


config SUPPORT_SLE_CENTRAL
    bool
    default y if (SAMPLE_SUPPORT_SLE_UART_CLIENT)

config SAMPLE_SUPPORT_EPAPER
    bool
    prompt "Support e-Paper Sample."
    default y
    depends on SAMPLE_SUPPORT_SLE_UART
    help
        This option means support e-Paper Sample.

config EPD_MASTER_BUS_ID
    int
    prompt "Choose SPI master bus id."
    depends on SAMPLE_SUPPORT_EPAPER
    default 0

config EPD_BUSY_PIN
    int
    prompt "Choose e-Paper BUSY pin."
    depends on SAMPLE_SUPPORT_EPAPER
    default 12

config EPD_DIN_PIN
    int
    prompt "Choose e-Paper DIN pin."
    depends on SAMPLE_SUPPORT_EPAPER
    default 9

config EPD_CLK_PIN
    int
    prompt "Choose e-Paper CLK pin."
    depends on SAMPLE_SUPPORT_EPAPER
    default 7

config EPD_CS_PIN
    int
    prompt "Choose e-Paper CS pin."
    depends on SAMPLE_SUPPORT_EPAPER
    default 8

config EPD_RST_PIN
    int
    prompt "Choose e-Paper RES pin."
    depends on SAMPLE_SUPPORT_EPAPER
    default 2

config EPD_PWR_PIN
    int
    prompt "Choose e-Paper PWR pin."
    depends on SAMPLE_SUPPORT_EPAPER
    default 11

config EPD_DC_PIN
    int
    prompt "Choose e-Paper DC pin."
    depends on SAMPLE_SUPPORT_EPAPER
    default 10
```
